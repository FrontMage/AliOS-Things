## board/gapoc_a_qpif/Config.in
```kconfig
config AOS_BOARD_GAPOC_A_QPIF
    bool "GAPOC_A_QPIF"
    select AOS_MCU_GAP8
    select AOS_COMP_KERNEL_INIT
    help

if AOS_BOARD_GAPOC_A_QPIF
# Configurations for board gapoc_a_qpif
endif
```

## board/gapuino8/Config.in
```kconfig
config AOS_BOARD_GAPUINO8
    bool "GAPUINO8"
    select AOS_MCU_GAP8
    select AOS_COMP_KERNEL_INIT
    help

if AOS_BOARD_GAPUINO8
# Configurations for board gapuino8
endif
```

## board/gvsoc_gap8/Config.in
```kconfig
config AOS_BOARD_GVSOC_GAP8
    bool "GVSOC_GAP8"
    select AOS_MCU_GAP8
    select AOS_COMP_KERNEL_INIT
    help

if AOS_BOARD_GVSOC_GAP8
# Configurations for board gapuino8
endif
```

## platform/arch/risc-v/ri5cy_gap8/Config.in
```kconfig
config AOS_ARCH_RI5CY_GAP8
    bool
    help
      arch for ri5cy

if AOS_ARCH_RI5CY_GAP8
# Configurations for arch ri5cy
endif
```

## platform/mcu/gap8/Config.in
```kconfig
config AOS_MCU_GAP8
    bool aos_mcu_gap8
    select AOS_ARCH_RI5CY_GAP8
    select AOS_COMP_RHINO
    select AOS_MCU_GAP8_AUTOTILER
    select AOS_MCU_GAP8_BASELIBC
    help
      driver & sdk for platform/mcu gap8

if AOS_MCU_GAP8
# Configurations for greenwaves autotiler
    source platform/mcu/gap8/autotiler_v3/Config.in
    source platform/mcu/gap8/libc/Config.in
endif
```

## platform/mcu/gap8/autotiler_v3/Config.in
```kconfig
config AOS_MCU_GAP8_AUTOTILER
    bool aos_mcu_gap8_autotiler
    help
      gap8 autotiler

if AOS_MCU_GAP8_AUTOTILER
# Configurations for mcu gap8
endif
```

## platform/mcu/gap8/libc/Config.in
```kconfig
config AOS_MCU_GAP8_BASELIBC
    bool aos_mcu_gap8_baselibc
    help
      gap8 baselibc tiny port

if AOS_MCU_GAP8_BASELIBC
# Configurations for mcu gap8
endif
```

## app/example/face_detection/Config.in
```kconfig
config AOS_APP_FACE_DETECTION_DEMO
    bool "gap_face_detection"
    select AOS_COMP_OSAL_AOS
    help
        GAP8 Face Detection Demo

if AOS_APP_FACE_DETECTION_DEMO
# Configurations for app face detection
endif
```

## app/example/gap_ble/Config.in
```kconfig
config AOS_APP_GAP_BLE
    bool "gap_ble"
    help
        this is a uart ble sample on gapoc

if AOS_APP_GAP_BLE
# Configurations for app gap ble
endif
```

## app/example/gap_bridge/Config.in
```kconfig
config AOS_APP_GAP_BRIDGE
    bool "gap_bridge"
    select AOS_COMP_OSAL_AOS
    help
        GAP8 Bridge Test

if AOS_APP_GAP_BRIDGE
# Configurations for app face reidentification
endif
```

## app/example/gap_camera/Config.in
```kconfig
config AOS_APP_GAP_CAMERA
    bool "gap_camera"
    select AOS_COMP_OSAL_AOS
    help
        GAP8 Camera Demo

if AOS_APP_GAP_CAMERA
# Configurations for app face detection
endif
```

## app/example/gap_cifar10/Config.in
```kconfig
config AOS_APP_GAP_CIFAR10
    bool "gap_cifar10"
    select AOS_COMP_OSAL_AOS
    help
        GAP8 Cifar10 Test

if AOS_APP_GAP_CIFAR10
# Configurations for app face detection
endif
```

## app/example/gap_face_detection/Config.in
```kconfig
config AOS_APP_GAP_FACE_DETECTION
    bool "gap_face_detection"
    select AOS_COMP_OSAL_AOS
    help
        GAP8 Face Detection Demo

if AOS_APP_GAP_FACE_DETECTION
# Configurations for app face detection
endif
```

## app/example/gap_face_reid/Config.in
```kconfig
config AOS_APP_GAP_FACE_REID
    bool "gap_face_reid"
    select AOS_COMP_OSAL_AOS
    help
        GAP8 Face ReID Demo

if AOS_APP_GAP_FACE_REID
# Configurations for app face reidentification
endif
```

## app/example/gap_fs/Config.in
```kconfig
config AOS_APP_GAP_FS
    bool "gap_fs"
    select AOS_COMP_OSAL_AOS
    help
        GAP8 Fs Test

if AOS_APP_GAP_FS
# Configurations for app face detection
endif
```

## app/example/gap_fs_to_l3_copy/Config.in
```kconfig
config AOS_APP_GAP_FS_TO_L3_COPY
    bool "gap_fs_to_l3_copy"
    select AOS_COMP_OSAL_AOS
    help
        GAP8 Fs_To_L3_Copy Test

if AOS_APP_GAP_FS_TO_L3_COPY
# Configurations for app face detection
endif
```

## app/example/gap_lora/Config.in
```kconfig
config AOS_APP_GAP_LORA
    bool "gap_lora"
    help
        this is a uart lora sample on gapoc

if AOS_APP_GAP_LORA
# Configurations for app gap lora
endif
```

## app/example/gap_mnist/Config.in
```kconfig
config AOS_APP_GAP_MNIST
    bool "gap_mnist"
    select AOS_COMP_OSAL_AOS
    help
        GAP8 Mnist Test

if AOS_APP_GAP_MNIST
# Configurations for app face reidentification
endif
```

## app/example/helloworld-multi-threads/Config.in
```kconfig
config AOS_APP_HELLOWORLD_MULTI_TH
    bool "helloworld-multi-threads"
    select AOS_COMP_OSAL_AOS
    help
        Hello World Multi Thread

if AOS_APP_HELLOWORLD_MULTI_TH
# Configurations for app helloworld multi thread
endif
```

## app/example/helloworld_cluster/Config.in
```kconfig
config AOS_APP_HELLOWORLD_CLUSTER
    bool "HelloWorld_Cluster"
    select AOS_COMP_OSAL_AOS
    help
        Hello World Cluster

if AOS_APP_HELLOWORLD_CLUSTER
# Configurations for app helloworld
endif
```

## app/example/helloworld_multi_th/Config.in
```kconfig
config AOS_APP_HELLOWORLD_MULTI_TH
    bool "helloworld_multi_th"
    select AOS_COMP_OSAL_AOS
    help
        Hello World Multi Thread

if AOS_APP_HELLOWORLD_MULTI_TH
# Configurations for app helloworld multi thread
endif
```

## app/example/hyperbus_test/Config.in
```kconfig
config AOS_APP_HYBERBUS_TEST
    bool "hyperbus_test"
    select AOS_COMP_OSAL_AOS
    help
        GAP8 Hyperbus test

if AOS_APP_HYBERBUS_TEST
# Configurations for app helloworld
endif
```

## app/example/image_dump/Config.in
```kconfig
config AOS_APP_IMAGE_DUMP
    bool "image_dump"
    select AOS_COMP_OSAL_AOS
    help
        Image dumper (to be used with openocd)

if AOS_APP_IMAGE_DUMP
# Configurations for app image_dump
endif
```

## app/example/openocd_semihosting/Config.in
```kconfig
config AOS_APP_OPENOCD_SEMIHOSTING
    bool "opencod_semihosting"
    select AOS_COMP_OSAL_AOS
    help
        openocd_semihosting

if AOS_APP_OPENOCD_SEMIHOSTING
# Configurations for app openocd semihosting
endif
```

## app/spi_flash_test/Config.in
```kconfig
config AOS_APP_SPI_FLASH_TEST
    bool "spi_flash_test"
    select AOS_COMP_OSAL_AOS
    help
        QPI flash test

if AOS_APP_SPI_FLASH_TEST
# Configurations for app spi flash test
endif
```

## app/spim_full_duplex/Config.in
```kconfig
config AOS_APP_SPIM_FULL_DUPLEX
    bool "spim_full_duplex"
    select AOS_COMP_OSAL_AOS
    help
        spim send with 1 chip select

if AOS_APP_SPIM_FULL_DUPLEX
# Configurations for gap pmsis spim full duplex test
endif
```

## app/spim_send_1cs/Config.in
```kconfig
config AOS_APP_SPIM_SEND_1CS
    bool "spim_send_1cs"
    select AOS_COMP_OSAL_AOS
    help
        spim send with 1 chip select

if AOS_APP_SPIM_SEND_1CS
# Configurations for gap pmsis spim send test
endif
```

## app/spim_send_2cs/Config.in
```kconfig
config AOS_APP_SPIM_SEND_2CS
    bool "spim_send_2cs"
    select AOS_COMP_OSAL_AOS
    help
        spim send with 1 chip select

if AOS_APP_SPIM_SEND_2CS
# Configurations for gap pmsis spim send test
endif
```

## app/spim_send_2cs_2dev/Config.in
```kconfig
config AOS_APP_SPIM_SEND_2CS_2DEV
    bool "spim_send_2cs_dev"
    select AOS_COMP_OSAL_AOS
    help
        spim send with 1 chip select

if AOS_APP_SPIM_SEND_2CS_2DEV
# Configurations for gap pmsis spim send test
endif
```

## app/uart_pmsis/Config.in
```kconfig
config AOS_APP_UART_PMSIS
    bool "uart_pmsis"
    help
        this is a uart sample form hal uart.h

if AOS_APP_UART_PMSIS
# Configurations for app uart
endif
```

## board/gap8_qpif_breakout/Config.in
```kconfig
config AOS_BOARD_GAP8_QPIF_BREAKOUT
    bool "GAP8_QPIF_BREAKOUT"
    select AOS_MCU_GAP8
    select AOS_COMP_KERNEL_INIT
    help

if AOS_BOARD_GAP8_QPIF_BREAKOUT
# Configurations for board gap8_qpif_breakout
endif
```

## board/gapoc_a/Config.in
```kconfig
config AOS_BOARD_GAPOC_A
    bool "GAPOC_A"
    select AOS_MCU_GAP8
    select AOS_COMP_KERNEL_INIT
    help

if AOS_BOARD_GAPOC_A
# Configurations for board gapoc_a
endif
```
